## firmware/main/Kconfig.projbuild
```kconfig
menu "EchoEar"
    config ECHOEAR_WIFI_SSID
        string "Wi-Fi SSID"
        default ""

    config ECHOEAR_WIFI_PASSWORD
        string "Wi-Fi password"
        default ""

    config ECHOEAR_BRIDGE_URL
        string "Bridge base URL (no trailing slash)"
        default ""

    config ECHOEAR_BRIDGE_TOKEN
        string "Bridge and device management token"
        default ""
endmenu
```

## firmware/sdkconfig.defaults
```kconfig
CONFIG_IDF_TARGET="esp32s3"
CONFIG_ESPTOOLPY_FLASHSIZE_16MB=y
CONFIG_ESPTOOLPY_FLASHMODE_QIO=y
CONFIG_SPIRAM=y
CONFIG_SPIRAM_MODE_OCT=y
CONFIG_SPIRAM_SPEED_80M=y
CONFIG_PARTITION_TABLE_CUSTOM=y
CONFIG_PARTITION_TABLE_CUSTOM_FILENAME="partitions.csv"
# esp_vocat 1.1.0 already targets the v1.2 pinout.
# CONFIG_CODEC_I2C_BACKWARD_COMPATIBLE is not set
CONFIG_BSP_LCD_DRAW_BUF_HEIGHT=32
CONFIG_HTTPD_MAX_REQ_HDR_LEN=1024
CONFIG_ESP_HTTP_CLIENT_ENABLE_HTTPS=y
CONFIG_ESP_HTTPS_OTA_ALLOW_HTTP=y
CONFIG_BOOTLOADER_APP_ROLLBACK_ENABLE=y
CONFIG_LWIP_SO_RCVBUF=y
CONFIG_ESP_MAIN_TASK_STACK_SIZE=8192
CONFIG_ESP_CONSOLE_USB_SERIAL_JTAG=y
CONFIG_LV_FONT_MONTSERRAT_16=y
CONFIG_LV_FONT_MONTSERRAT_20=y
CONFIG_LV_FONT_MONTSERRAT_24=y
# CONFIG_LV_BUILD_EXAMPLES is not set
# CONFIG_LV_BUILD_DEMOS is not set
```
